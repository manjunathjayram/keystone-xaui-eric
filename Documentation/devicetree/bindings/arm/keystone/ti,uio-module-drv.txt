## Documentation/devicetree/bindings/net/keystone-net.txt
```
This document describes the device tree bindings associated with the
keystone network driver support.

reg:		the register start address and the size that will be
		used by the driver. The second index is for the efuse
		mac address
tx-channel:	the packet dma channel name associated with tx
tx-queue-depth: the number of descriptors to be used
rx-channel:	the packet dma channel name associated with rx
rx-queue-depth: there can be at present a maximum of 4 queues per packet
		dma channel. We can specify the number of descriptors for
		each queue
rx-buffer-size: For each receive queue, we can specify a buffer size.
efuse-mac:	If this is 1, then the mac address is obtained from the
		device efuse mac address register
local-mac-address:the driver is designed to use the of_get_mac_address api
		  only if efuse-mac is 0. When efuse-mac is 0, the mac address
		  is obtained from local-mac-address.
link-interface: for each slave port that is intended to be used, a
                link-interface binding has to be used appropriatley
		initialized. The different options are as follows
		- for mac mac auto negotiate mode use -> 0
		- for mac phy mode use -> 1
		- for mac mac forced mode use -> 2
		- for mac fiber mode use -> 3
		- for mac phy mode with no mdio use -> 4

The keystone network device can open other modules such as cpsw or pa.

Below we provide an example.

netcp: netcp@2090000 {
			reg = <0x2090000 0xf00
				0x2620110 0x8>;
			compatible = "ti,keystone-netcp";

			tx-channel = "nettx";
			tx-queue-depth = <128>;

			rx-channel = "netrx";
			rx-queue-depth = < 128 128 0 0>;
			rx-buffer-size = <1500 4096 0 0>;

			efuse-mac = <1>;
			local-mac-address = [00 18 31 7e 3e 6e];

			slaves {
					slave0 {
						label		= "slave0";
						link-interface	= <1>;
					};
					slave1 {
						label		= "slave1";
						link-interface	= <1>;
					};

			};

			pa: pa@2000000 {
				label = "keystone-pa";
			};
		};
```

## Documentation/devicetree/bindings/pci/pcie-keystone.txt
```
Keystone PCIE Root complex device tree bindings
-----------------------------------------------

Sample bindings shown below:-

 - Remove enable-linktrain if boot loader already does Link training and do EP
   configuration.
 - To Disable SERDES initialization during Linux boot up, remove the "Keystone2 serdes cfg"
   reg values from the reg property.

	pci-controller@21800000 {
		device_type = "pci";
		#address-cells = <3>;
		#size-cells = <2>;
		#interrupt-cells = <2>;
		compatible = "ti,keystone2-pci";
		reg =  <0x21800000 0x8000	/* pcie-regs */
			0x0262014c 4		/* device cfg */
			0x02320000 0x4000>;	/* Keystone2 serdes cfg */

		/* outbound pci resources */
		ranges = <0x02000000 0 0x50000000 0x50000000 0 0x10000000
				  0x01000000 0 0 0x24000000 0 0x4000>;

		/* inbound dma range */
		dma-ranges = <0x02000000 0 0x80000000 0x80000000 0 0x20000000>;

		interrupt-parent = <&gic>;
		interrupts = <0 26 0xf01 0 27 0xf01 0 28 0xf01 0 29 0xf01 /* 4 Legacy IRQs */
			      0 30 0xf01 0 31 0xf01 0 32 0xf01 0 33 0xf01 /* 8 MSI IRQs */
			      0 34 0xf01 0 35 0xf01 0 36 0xf01 0 37 0xf01
			      0 38 0xf01>; /* Error IRQ */
		clocks = <&clkpcie>;
		clock-names = "pcie";
		enable-linktrain; /* When the boot loader enables link train and configure ep
				   * remove this attribute */
	};
```

## Documentation/devicetree/bindings/phy/phy-serdes-keystone.txt
```
TI Keystone SerDes Phy: DT documentation
=======================================

Required properties:
 - compatible: should be "ti,keystone-serdes-phy";
 - reg: base address and length of the SerDes register set
 - reg-names: should be "reg_serdes", name of the reg SerDes register set
 - #phy-cells: from the generic phy bindings, must be 0;

Exampel for Keystone PCIE,

		pcie0_phy: serdes_phy@2320000 {
			#phy-cells = <0>;
			compatible = "ti,keystone-serdes-phy";
			reg = <0x02320000 0x4000>;
			reg-names = "reg_serdes";
		};


Then the PHY can be used in PCIe controller node as

pcie@21800000 {
	phys = <&pcie0_phy>;
	phy-names = "pcie-phy";
};
```

## Documentation/devicetree/bindings/power/reset/keystone-reset.txt
```
* Device tree bindings for Texas Instruments keystone reset

This node is intended to allow SoC reset in case of software reset
of selected watchdogs.

The Keystone SoCs can contain up to 4 watchdog timers to reset
SoC. Each watchdog timer event input is connected to the Reset Mux
block. The Reset Mux block can be configured to cause reset or not.

Additionally soft or hard reset can be configured.

Required properties:

- compatible:		ti,keystone-reset

- reg:			Contains offset/length value for mux registers.

			reg = <0x23100e4 0x10>,
			      <0x2620328 0x10>;

-reg-names:		Contains two ranges "pllregs" and "muxregs".
			"pllregs" - PLL reset control regs: RSTYPE, RSCTRL,
			RSCFG, RSISO.
			"muxregs" - mux block registers for all watchdogs.

Optional properties:

- ti,soft-reset:	Boolean option indicating soft reset.
			By default hard reset is used.

- ti,wdt_list:		WDT list that can cause SoC reset.
			The list in format: <0>, <2>;
			Begins from 0 to 3, as keystone can contain up
			to 4 SoC reset watchdogs.

Example 1:
Setup keystone reset so that in case software reset or
WDT1 is triggered it issues hard reset for SoC.

rstctrl: reset-controller {
	compatible = "ti,keystone-reset";
	reg = <0x23100e4 0x10>,
	      <0x2620328 0x10>;
	reg-names = "pllregs", "muxregs";
	ti,wdt_list = <0>;
};

Example 2:
Setup keystone reset so that in case of software reset or
WDT1 or WDT3 is triggered it issues soft reset for SoC.

rstctrl: reset-controller {
	compatible = "ti,keystone-reset";
	reg = <0x23100e4 0x10>,
	      <0x2620328 0x10>;
	reg-names = "pllregs", "muxregs";
	ti,wdt_list = <0>, <2>;
	ti,soft-reset;
};
```

## Documentation/devicetree/bindings/rapidio/keystone-srio.txt
```
This document describes the device tree bindings associated with the KeyStone
Serial RapidIO driver support.

Required properties
-------------------

#address-cells
#size-cells:      Should be '1' if the device has sub-nodes with 'reg' property.
reg:              Address and length of the register set for the SRIO subsystem on
                  the SOC. There are three ranges of registers:
		   - RapidIO registers
		   - boot configuration registers (for JTAGID and K1 SerDes setup)
		   - SerDes configuration registers
clocks:           Clock IDs array as required by the controller.
clock-names:      Names of clocks corresponding to IDs in the clock property.
compatible:       Should be "ti,keystone-rapidio".
interrupts:       The two IRQ definitions for:
		   - RIO special interrupts (doorbell, error, port-write in, ...)
                   - LSU completion.

Optional properties
-------------------

dma-coherent:     Indicate if DirectIO operations support hw cache-coherency.
		  On KeyStone platforms it is recommended to set this property
		  when running on ARM cores.
keystone2-serdes: Indicate that the driver needs to use KeyStone 2 SerDes
		  initialization. If not specified, it will be KeyStone 1
		  initialization instead.
baudrate:         This the lane baudrate configuration number (from 0 to 3).
		  If not specified the baudrate configuration 0 will be used
                  (1.25Gbps).
path_mode:        This is the SerDes lane to port configuration number (from 0 to 4).
		  If not specified the mode 0 will be used (4 ports in 1x).
port-register-timeout:
		  This is the delay in seconds for waiting the port registration at
                  startup. if not specified a default 30 second value will be used.
ports:            This is the bitfield of RapidIO port(s) to probe at startup.
		  If not specified, no port will be used.
dev-id-size:      RapidIO common transport system size:
                   0 - Small size, 8-bit deviceID fields, 256 devices.
                   1 - Large size, 16-bit deviceID fields, 65536 devices.
		  If not specifed 0 (8-bit) value will be used.
lsu:              Index of the two LSUs that will be used for DirectIO transfers and
		  maintenance requests. If not specified LSU 0 will be used for both
		  (LSUs can be shared).
tx_channel:       This is the packet DMA channel name associated with MP transmit.
                  If not specified the "riotx" name will be used.
tx_queue_depth:   Number of descriptors for the transmit queue. Default is 128
                  descriptors.
num-mboxes:       Number of receive mailboxes used for MP. If not specified, only one
		  mailbox will be used.
pkt-forward:      This allow to define the routing table for hardware packet
		  forwarding. There are 8 entries in the table. Each entry starts
		  with the lower DeviceID boundary, then the upper DeviceID boundary
		  and the output port to route packets whose DestID falls within the
		  described range.
		  For example, '0x3 0x3 1' will forward incoming packets with DestID
		  0x3 to port 1.
		  All the 8 entries must be referenced with the 3 values.

SerDes optional properties
--------------------------

These properties are used to tune the KeyStone 2 SerDes hardware parameters and
coefficients. For more information please refer to KeyStone II Architecture
Serializer/Deserializer (SerDes) User Guide (SPRUHO3) available on www.ti.com.

serdes_1sb:       Allow to set the TX driver 1 lsb pre emphasis setting for KeyStone
		  2 SerDes. There is one value per lane. Default value is 0.
serdes_c1:        Allow to override value of TX driver C1 coefficient for KeyStone
		  2 SerDes. There is one value per lane. Default value if not
		  specified is 6 for 3.125Gbps and 4 for other baudrates.
serdes_c2:        Allow to override value of TX driver C2 coefficient for KeyStone
		  2 SerDes. There is one value per lane. Default value is 0 if not
		  specified.
serdes_cm:	  Allow to override value of TX driver CM coefficient for KeyStone
		  2 SerDes. There is one value per lane. Default value is 0.
serdes_att:       Allow to set attenuator setting of TX driver for KeyStone 2 SerDes.
		  There is one value per lane. Default value is 12 if not specified.
serdes_vreg:      Allow to set regulator voltage setting for TX driver for KeyStone 2
		  SerDes. There is one value per lane. Default value is 4 if not
		  specified.
serdes_vdreg:     Allow to set lane regulator output voltage setting for TX driver
                  for KeyStone 2. Default value is 1 (VNOM) if not specified.
serdes_rx_att_start:
                  Allow to set attenuator start value of RX driver for Keystone 2
                  SerDes. There is one value per lane. Default value is 3.
serdes_rx_boost_start:
                  Allow to set attenuator start value of RX driver for Keystone 2
		  SerDes. There is one value per lane. Default value is 3.
serdes_rx_att:    Allow to set attenuator static value of RX driver for Keystone 2
                  SerDes. If set to -1, dynamic calibration is used instead.
                  There is one value per lane. Default value is -1 (dynamic cal).
serdes_rx_boost:  Allow to set attenuator start value of RX driver for Keystone 2
                  SerDes. If set to -1, dynamic calibration is used instead.
                  There is one value per lane. Default value is -1 (dynamic cal).

Sub-nodes
---------

Each mailbox (according to num-mboxes) must be added as subnodes "mbox-%d" with %d the
mailbox number (from 0 to n).
This sub-node has the following properties:

rx_channel:       The packet DMA channel associated to this receive mailbox.
rx_queue_depth:   There can be at present a maximum of 4 queues per packet DMA channel.
		  We can specify the number of descriptors for each queue.
rx-buffer-size:   For each receive queue, we can specify the buffer size.
stream_id:        If specified, the mailbox will be mapped to the indicated stream ID
		  and packet type 9 will be used instead of packet type 11.

Example
-------

rapidio: rapidio@2900000 {
	#address-cells = <1>;
        #size-cells = <1>;
        reg = <0x2900000 0x40000        /* rio regs */
               0x2620000 0x1000         /* boot config regs */
	       0x232c000 0x2000>;       /* serdes config regs */
        clocks = <&clksrio>;
        clock-names = "clk_srio";
        compatible = "ti,keystone-rapidio";
	dma-coherent;

        keystone2-serdes;
        baudrate  = <3>;              /* 5Gbps */
        path_mode = <4>;              /* 1 ports in 4x */
	port-register-timeout = <30>; /* 30 seconds */
	lsu       = <0 0>;            /* DIO and maintenance LSUs */

        tx_channel = "riotx";
        tx_queue_depth = <256>;

        ports = <0x1>;      /* bitfield of port(s) to probe */
        dev-id-size = <0>;  /* RapidIO common transport system
                             * size.
                             * 0 - Small size. 8-bit deviceID
                             *     fields. 256 devices.
                             * 1 - Large size, 16-bit deviceID
                             *     fields. 65536 devices.
                             */
	interrupts = <0 152 0xf01 0 153 0xf01>; /* RIO and LSU IRQs */

        num-mboxes = <2>;

        mbox-0 {
	        rx_channel = "riorx0";
                rx_queue_depth  = <256 0 0 0>;
                rx_buffer_size  = <4096 0 0 0>;
                /*stream_id = <0>;*/
        };

        mbox-1 {
	        rx_channel = "riorx1";
                rx_queue_depth  = <256 0 0 0>;
                rx_buffer_size  = <4096 0 0 0>;
                /*stream_id = <1>;*/
        };
};
```

## Documentation/devicetree/bindings/spi/spi-davinci.txt
```
Davinci SPI controller device bindings

Required properties:
- #address-cells: number of cells required to define a chip select
	address on the SPI bus. Should be set to 1.
- #size-cells: should be zero.
- compatible:
	- "ti,davinci-spi-v1" for SPI version 1.0
	- "ti,davinci-spi-v2" for SPI version 2.0
- reg: Offset and length of SPI controller register space
- ti,davinci-spi-num-cs: Number of chip selects. This includes
	internal as well as GPIO chip selects.
- ti,davinci-spi-intr-line: interrupt line used to connect the SPI
	IP to the interrupt controller withn the SoC. Possible values
	are 0 and 1. Manual says one of the two possible interrupt
	lines can be tied to the interrupt controller. Set this
	based on a specifc SoC configuration.
- interrupts: interrupt number offset at the irq parent
- clocks: spi clk phandle

Optional:
- cs-gpios: gpio chip selects
	For example to have 3 internal CS and 2 GPIO CS, user could define
	cs-gpios = <0>, <0>, <0>, <&gpio1 30 0>, <&gpio1 31 0>;
	where first three are internal CS and last two are GPIO CS.

Example of a NOR flash slave device (n25q032) connected to DaVinci
SPI controller device over the SPI bus.

spi0:spi@20BF0000 {
	#address-cells			= <1>;
	#size-cells			= <0>;
	compatible			= "ti,davinci-spi-v1";
	reg				= <0x20BF0000 0x1000>;
	ti,davinci-spi-num-cs		= <4>;
	ti,davinci-spi-intr-line	= <0>;
	interrupts			= <338>;
	clocks				= <&clkspi>;

	flash: n25q032@0 {
		#address-cells = <1>;
		#size-cells = <1>;
		compatible = "st,m25p32";
		spi-max-frequency = <25000000>;
		reg = <0>;

		partition@0 {
			label = "u-boot-spl";
			reg = <0x0 0x80000>;
			read-only;
		};

		partition@1 {
			label = "test";
			reg = <0x80000 0x380000>;
		};
	};
};

SPI slave nodes must be children of the SPI master node and can
contain the following properties. Not all SPI Peripherals from
Texas Instruments support this. Please check SPI peripheral UG
for a device before using these.

- ti,davinci-spi-wdelay : delay between transmissions.
- ti,davinci-spi-odd-parity : odd partity enabled
   OR
- ti,davinci-spi-even-parity : even parity enabled
- ti,davinci-spi-io-type: io type (check platform_data/spi-davinci.h)
- ti,davinci-spi-disable-timer: disable CS timer (SPIFMTn)
- ti,davinci-spi-c2t-delay: c2t delay
- ti,davinci-spi-t2c-delay: t2c delay
- ti,davinci-spi-t2e-delay: t2e delay
- ti,davinci-spi-c2e-delay: c2e delay
```
