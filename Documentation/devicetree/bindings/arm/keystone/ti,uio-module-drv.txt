## Documentation/devicetree/bindings/arm/keystone/ti,uio-module-drv.txt
```
UIO Peripheral Modules

This file provides information about, what the device tree entry for the
uio accesible peripheral module device should contain.

Required properties:
- compatible : "ti,uio-module-drv"
- reg : Register start address and the size that will be
		used by the driver
 or
  mem : Register/Memory start address and size of the Register/memory region.
- label  : label used for misc device registration


Recommended properties :
- interrupts : standard interrupt property
- clocks : desired clock domain property

Optional properties:
- cfg-params: Specifies configuration parameters to be used with specific peripherals
	ti,serdes_refclk_khz: serdes reference clock in khz
	ti,serdes_maxserrate_khz: serdes maximum serial rate in khz
	ti,serdes_maxlanerate: Lane rate "half" or "full"
	ti,serdes_numlanes: Number of lanes
	The following are serdes equilization tap parameters
	ti,serdes_c1	: Serdes c1 coefficient (0-31), one per lane
	ti,serdes_c2	: Serdes c2 coefficient (0-15), one per lane
	ti,serdes_cm	: Serdes cm coefficient (0-15), one per lane
	ti,serdes_tx_att: Transmit att, one per lane
	ti,serdes_tx_vreg: Transmit vreg, one per lane
	ti,serdes_rx_att: Receive att, one per lane
	ti,serdes_rx_boost: Receive boost, one per lane
	ti,qm-queue     : QMSS queue associated with qpend binding

Example:

	uio_hyperlink0: hyperlink0 {
		compatible = "ti,uio-module-drv";
		mem  = <0x21400000 0x00000100
			0x40000000 0x10000000
			0x0231a000 0x00002000>;
		clocks = <&clkhyperlink0>;
		interrupts	= <0 387 0x101>;
		label = "hyperlink0";
		cfg-params
		{
			ti,serdes_refclk_khz = <312500>;
			ti,serdes_maxserrate_khz = <6250000>;
			ti,serdes_lanerate = "half";
			ti,serdes_numlanes = <4>;
			ti,serdes_c1 = <4 4 4 4>;
			ti,serdes_c2 = <0 0 0 0>;
			ti,serdes_cm = <0 0 0 0>;
			ti,serdes_tx_att = <12 12 12 12>;
			ti,serdes_tx_vreg = <4 4 4 4>;
			ti,serdes_rx_att = <11 11 11 11>;
			ti,serdes_rx_boost = <3 3 3 3>;
		};
	};
```

## Documentation/devicetree/bindings/clock/clk-davinci-psc.txt
```
Binding for davinci psc clocks

This binding uses the common clock binding[1].

[1] Documentation/devicetree/bindings/clock/clock-bindings.txt

Required properties:
- compatible : shall be "davinci,psc-clk".
- #clock-cells : from common clock binding; shall be set to 0.
- clocks : parent clock phandle
- reg :	psc base register address space

Optional properties:
- clock-output-names : From common clock binding to override the
			default output clock name
- status : "enabled" if clock is always enabled
- lpsc : lpsc module id, if not set defaults to zero
- pd : power domain number, if not set defaults to zero (always ON)
- gpsc : gpsc number, if not set defaults to zero
- base-flags : base flag used by clk framwork. Currently supports only
	 "ignore-unused" that avoids disabling unused clocks

Example:
	clock {
		#clock-cells = <0>;
		compatible = "davinci,psc-clk";
		clocks = <&chipclk3>;
		clock-output-names = "debugss_trc";
		base-flags = "ignore-unused";
		reg = <0x02350000 4096>;
		lpsc = <5>;
		pd = <1>;

	};
```

## Documentation/devicetree/bindings/clock/clk-keystone-pll.txt
```
Binding for keystone main pll clocks

This binding uses the common clock binding[1].

[1] Documentation/devicetree/bindings/clock/clock-bindings.txt

Required properties:
- compatible : shall be "keystone,main-pll-clk".
- #clock-cells : from common clock binding; shall be set to 0.
- clocks : parent clock phandle
- reg - index 0 -  PLLCTRL PLLM register address
- 	index 1 -  MAINPLL_CTL0 register address
- pllm_lower_mask - pllm lower bit mask
- pllm_upper_mask - pllm upper bit mask
- plld_mask - plld mask
- fixed_postdiv - fixed post divider value

Example:
	clock {
		#clock-cells = <0>;
		compatible = "keystone,main-pll-clk";
		clocks = <&refclk>;
		reg = <0x02310110 4	/* PLLCTRL PLLM */
			0x02620328 4>;	/* MAINPLL_CTL0 */
		pllm_lower_mask	= <0x3f>;
		pllm_upper_mask = <0x7f000>;
		pllm_upper_shift = <6>;
		plld_mask = <0x3f>;
		fixed_postdiv = <2>;
	};
```

## Documentation/devicetree/bindings/gpio/gpio-keystone.txt
```
Keystone GPIO controller bindings

Required properties:
- compatible : Should be "ti,keystone-gpio"
- reg : Address and length of the register set for the device. For
	first bank, 2 reg entries required. At index 0 specify base
	of common registers at the beginning of gpio address space that
	includes BINTEN. This should have a size 0x10. At second index
	specify base address of bank0 & 1. For subsequent bank, only
	one reg entry should be specified and should be poiting to
	base of the bank.
- gpio-controller : Marks the device node as a gpio controller.
- #gpio-cells : Should be 2.  First cell specify the pin number and
	second is optional parameter (unused).
- clocks: phandle to clock node
- clock-names: name of the input clock
- interrupt-controller: Marks the device node as an interrupt controller.
- #interrupt-cells: Should be 2. The first cell is the GPIO number.
  The second cell bits[3:0] is used to specify trigger type:
	1 = low-to-high edge triggered.
	2 = high-to-low edge triggered.

Note: Each GPIO port should have an alias correctly numbered in "aliases"
node.

Examples:

aliases {
        gpio0 = &gpio0;
        gpio1 = &gpio1;
        gpio2 = &gpio2;
        gpio3 = &gpio3;
        gpio4 = &gpio4;
};

gpio0: gpio@2320000 {
	compatible = "ti,keystone-gpio";
	reg = <0x02320000 0x10
		0x02320010 0x28>;
	gpio-controller;
	#gpio-cells = <2>;
	interrupt-controller;
	#interrupt-cells = <2>;
	clocks = <&clkgpio>;
	clock-names = "gpio";
};

To use gpio pins in the driver, include the phandle to the gpio device bindings
in the specific driver device bindings.

Example:

following commands in the DT bindings of the device refers to gpio0, pin 20:-

	test-gpios = <&gpio0 20 0x2>;

Third argument (0x2) is the flag and is currently not used. Driver typically use
the API of_get_named_gpio_flags() to refers to the specific gpio pin and use GPIO
libraries to configure the pin.

To use the gpio pin as an interrupt line, set the interrupt-parent to
gpio driver device node that is associated with the gpio pin and include a
interrupts property in the driver's device bindings to specify the irq number and
flag as

	interrupts = <20 0x2>
	interrupt-parent = <&gpio0>;

where gpio pin 20 is configured as interrupt line and flag is set to high to low
edge triggered. gpio0 node is the interrupt-parent.
```

## Documentation/devicetree/bindings/hwqueue/keystone-hwqueue.txt
```
* Texas Instruments Keystone hwqueue driver

Required properties:
- compatible : Should be  "ti,keystone-hwqueue";
- reg : Address and length of the register set for the device for peek,
	push/pop etc.
- range		: <start number> total range of hwqueue numbers for the device
- region	: <start number> of memory regions to use
- linkram0	: <start number> of total link ram indices available
- linkram1	: <start number> of total external linking ram indices
		  available
- link-index	: <start number> of link ram indices to use
- queues	: number of queues to use per queue range name (see example below)
- descriptors	: number and size of descriptors to use per hwqueue instance
		   name (see example below)

- qmgrs         : the number of individual queue managers in the device. On
                  keystone 1 range of devices there should be only one node.
		  On keystone 2 devices there can be more than 1 node
  -- managed-queues : the actual queues managed by each queue manager instance

Optional properties:
- pdsps - PDSP configuration, if any.
- qos-inputs - quality of service configuration

The following explains the various attributes

- values = <start number> : number of queues staring at queue number start are
			    reserved for QoS
- pdsp-id = <x>           : the qmss pdsp that has the QoS firmware
- ticks-per-sec = <ticks> : the ticks per sec
- sched-port-configs = <start count size> : scheduler port start index,
					    number of scheduler ports,
					    size of address space for
					    scheduler port
- drop-out-profiles = <start count size>  : output profile start index,
					    number of output profiles,
					    size of address space for
					    output profile
- drop-cfg-profiles = <start count size>  : config profile start index,
					    number of config profiles,
					    size of address space for
					    config profile
- drop-queue-configs = <start count size> : drop queue config start index,
					    number of drop queue configs,
					    size of queue config address space
- statistic-profiles = <start count>      : statistics profile start index,
					    number of statistics profiles
- drop-policies = <&droppolicies>         : phandle for drop policies
- qos-tree = <&qostree>                   : phandle for the qos tree
					    configuration

Example:

hwqueue0: hwqueue@2a00000 {
		compatible = "ti,keystone-hwqueue";
		#address-cells = <1>;
		#size-cells = <1>;
		ranges;
		reg		= <0x2a00000 0xc0000>;
		range		= <0 0x2000>;
		linkram0	= <0x80000 0x4000>;
		linkram1	= <0x0 0x10000>;

		qmgrs {
			#address-cells = <1>;
			#size-cells = <1>;
			ranges;
			qmgr0 {
				managed-queues = <0 0x2000>;	/* managed queues */
				reg = <0x2a00000 0x20000	/* 0 - peek	*/
				       0x2a62000 0x6000		/* 1 - status	*/
				       0x2a68000 0x2000		/* 2 - config	*/
				       0x2a6a000 0x4000		/* 3 - region	*/
				       0x2a40000 0x20000	/* 4 - push	*/
				       0x2a20000 0x20000>;	/* 5 - pop	*/
			};
		};

		queues {
			qpend-arm {
				values = <650 8>;
				irq-base= <41>;
				reserved;
			};
			general {
				values = <4000 64>;
			};
			pa {
				values = <640 9>;
				reserved;
			};
			infradma {
				values = <800 12>;
				reserved;
			};
			accumulator-low-0 {
				values = <0 32>;
				// pdsp-id, channel, entries, pacing mode, latency
				accumulator = <0 32 8 2 0>;
				irq-base = <363>;
				multi-queue;
				reserved;
			};
			accumulator-low-1 {
				values = <32 32>;
				// pdsp-id, channel, entries, pacing mode, latency
				accumulator = <0 33 8 2 0>;
				irq-base = <364>;
				multi-queue;
			};
			accumulator-low-2 {
				values = <64 32>;
				// pdsp-id, channel, entries, pacing mode, latency
				accumulator = <0 34 8 2 0>;
				irq-base = <365>;
				multi-queue;
			};
			accumulator-low-3 {
				values = <96 32>;
				// pdsp-id, channel, entries, pacing mode, latency
				accumulator = <0 35 8 2 0>;
				irq-base = <366>;
				multi-queue;
			};
			accumulator-high {
				values = <728 8>;
				// pdsp-id, channel, entries, pacing mode, latency
				accumulator = <0 20 8 2 0>;
				irq-base = <150>;
				reserved;
			};
			qos-inputs {
				values			= <8000 192>;
				pdsp-id			= <1>;
				ticks-per-sec		= <10000>;
				qos-cfg			= <4 50 1 1 0xf00 0 0>;
				sched-port-configs	= <0 20 0x1c8>;
				drop-out-profiles	= <0 36 0xc>;
				drop-cfg-profiles	= <0 8 0x14>;
				drop-queue-configs	= <0 80 0x4>;
				statistics-profiles	= <0 48>;
				drop-policies		= <&droppolicies>;
				qos-tree		= <&qostree>;
				reserved;
			};
			riotx {
				values = <672 1>;
				reserved;
			};
		};
		regions {
			#address-cells = <1>;
			#size-cells = <1>;
			ranges;
			region-12 {
				id = <12>;
				values	= <4096 128>;	/* num_desc desc_size */
				link-index = <0x4000>;
			};
		};
		descriptors {
			pool-net {
				values = <2048 128>;	/* num_desc desc_size */
				region-id = <12>;
			};
			pool-udma {
				values = <1152 128>;	/* num_desc desc_size */
				region-id = <12>;
			};
			pool-rio {
				values = <128 128>;
				region-id = <12>;
			};
		};
		pdsps {
			#address-cells = <1>;
			#size-cells = <1>;
			ranges;
			pdsp0@0x2a60000 {
				firmware = "keystone/qmss_pdsp_acc48_le_1_0_3_12.fw";
				reg = <0x2a60000 0x1000    /*iram */
				       0x2a6e000 0x1000    /*reg*/
				       0x2aa0000 0x3c8	   /*intd */
				       0x2ab8000 0x4000>;  /*cmd*/
				id = <0>;
			};
			pdsp1@0x2a61000 {
				firmware = "keystone/qmss_qos.fw";
				reg = <0x2a61000 0x1000    /*iram */
				       0x2a6f000 0x1000    /*reg*/
				       0x2aa0000 0x3c8	   /*intd */
				       0x2abc000 0x4000>;  /*cmd*/
				id = <1>;
			};
		};
	};
```

## Documentation/devicetree/bindings/memory/davinci-aemif.txt
```
* Texas Instruments Davinci AEMIF bus interface

This file provides information for the davinci-emif device and
async bus bindings.

Required properties:=
- compatible: "ti,davinci-aemif";
- #address-cells : Should be either two or three.  The first cell is the
                   chipselect number, and the remaining cells are the
                   offset into the chipselect.
- #size-cells : Either one or two, depending on how large each chipselect
                can be.
- reg : contains offset/length value for AEMIF control registers space
- ranges : Each range corresponds to a single chipselect, and cover
           the entire access window as configured.

Child device nodes describe the devices connected to IFC such as NOR (e.g.
cfi-flash) and NAND (ti,davinci-nand, see Documentation/devicetree/bindings/
mtd/davinci-nand.txt). There might be board specific devices like FPGAs.

In addition, optional child sub nodes contains bindings for the async bus
interface for a given chip select.

Optional cs node properties:-
- compatible: "ti,davinci-cs"

  All of the params below in nanoseconds and are optional

- ti,davinci-cs-asize - asynchronous data bus width (0 - 8bit, 1 - 16 bit)
- ti,davinci-cs-ta - Minimum turn around time
- ti,davinci-cs-rhold - read hold width
- ti,davinci-cs-rstobe - read strobe width
- ti,davinci-cs-rsetup - read setup width
- ti,davinci-cs-whold - write hold width
- ti,davinci-cs-wstrobe - write strobe width
- ti,davinci-cs-wsetup - write setup width
- ti,davinci-cs-ss - enable/disable select strobe (0 - disable, 1 - enable)
- ti,davinci-cs-ew - enable/disable extended wait cycles (0 - disable, 1 - enable)

if any of the above parameters are absent, hardware register default or that
set by a boot loader are used.

Example for aemif, davinci nand and nor flash chip select shown below.

aemif@60000000 {
	compatible = "ti,davinci-aemif";
	#address-cells = <2>;
	#size-cells = <1>;
	reg = <0x68000000 0x80000>;
	ranges = <2 0 0x60000000 0x02000000
		  3 0 0x62000000 0x02000000
		  4 0 0x64000000 0x02000000
		  5 0 0x66000000 0x02000000
		  6 0 0x68000000 0x02000000>;

	nand_cs:cs2@60000000 {
		compatible = "ti,davinci-cs";
		#address-cells = <1>;
		#size-cells = <1>;
		/* all timings in nanoseconds */
		ti,davinci-cs-ta = <0>;
		ti,davinci-cs-rhold = <7>;
		ti,davinci-cs-rstrobe = <42>;
		ti,davinci-cs-rsetup = <14>;
		ti,davinci-cs-whold = <7>;
		ti,davinci-cs-wstrobe = <42>;
		ti,davinci-cs-wsetup = <14>;
	};

	nor_cs:cs3@62000000 {
		compatible = "ti,davinci-cs";
		#address-cells = <1>;
		#size-cells = <1>;
		/* all timings in nanoseconds */
		ti,davinci-cs-ta = <0>;
		ti,davinci-cs-rhold = <7>;
		ti,davinci-cs-rstrobe = <42>;
		ti,davinci-cs-rsetup = <14>;
		ti,davinci-cs-whold = <7>;
		ti,davinci-cs-wstrobe = <42>;
		ti,davinci-cs-wsetup = <14>;
		ti,davinci-cs-asize = <1>;
	};

	nand@3,0 {
		compatible = "ti,davinci-nand";
		reg = <3 0x0 0x807ff
			6 0x0 0x8000>;
		#address-cells = <1>;
		#size-cells = <1>;

		.. See Documentation/devicetree/bindings/mtd/davinci-nand.txt
	};

	flash@2,0 {
		compatible = "cfi-flash";
		reg = <2 0x0 0x400000>;
		#address-cells = <1>;
		#size-cells = <1>;
		bank-width = <2>;
		device-width = <2>;
	};
};
```

## Documentation/devicetree/bindings/mtd/st-m25p.txt
```
* STMicroelectronics SPI Flash

Required properties:
- compatible : "st,<model>", "st,m25p".

Examples:

flash: m25p32@1 {
	#address-cells = <1>;
	#size-cells = <1>;
	compatible = "st,m25p32", "st,m25p";
	spi-max-frequency = <20000000>;
	reg = <1>;
};
```
